## boards/shields/suspad/Kconfig.defconfig
```kconfig
# Copyright (c) 2020 The ZMK Contributors
# SPDX-License-Identifier: MIT

if SHIELD_SUSPAD

config ZMK_KEYBOARD_NAME
    default "Suspad"

endif
```

## boards/shields/suspad/Kconfig.shield
```kconfig
# Copyright (c) 2020 The ZMK Contributors
# SPDX-License-Identifier: MIT

config SHIELD_SUSPAD
   def_bool $(shields_list_contains,suspad)
```
